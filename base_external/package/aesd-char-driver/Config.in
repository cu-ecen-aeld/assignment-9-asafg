## base_external/package/aesd-char-driver/Config.in
```kconfig
config BR2_PACKAGE_AESD_CHAR_DRIVER
	bool "aesd-char-driver"
	help
	  Includes AESD char driver kernel module from AESD course
	  and init scripts to load the module at startup.
```

## base_external/package/ldd/Config.in
```kconfig
config BR2_PACKAGE_LDD
	bool "ldd"
	help
	  Includes kernel module examples
	  from Linux Device Drivers 3rd Edition
	  and init scripts to load them at startup.
```
